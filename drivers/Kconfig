## drivers/Kconfig
```kconfig
# SPDX-License-Identifier: Apache-2.0
rsource "audio/Kconfig"
rsource "mfd/Kconfig"
```

## drivers/audio/Kconfig
```kconfig
# Copyright (c) 2026 Hsiu-Chi Tsai
# SPDX-License-Identifier: Apache-2.0

rsource "Kconfig.es8311"
```

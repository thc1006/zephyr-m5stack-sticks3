## drivers/adc/Kconfig.m5pm1
```kconfig
# Copyright (c) 2026 The Zephyr Project Contributors
# SPDX-License-Identifier: Apache-2.0
#
# Vendored from Zephyr PR #109961
# (commit 49788e986286245610c15fc36bd0cd73baba0011), Apache-2.0.
# Interim copy; #109961 MERGED upstream 2026-06-03 (drop when Zephyr is bumped past 4.4.0).
# See docs/07_UPSTREAM_PLAN.md.

config ADC_M5PM1
	bool "M5Stack M5PM1 ADC driver"
	default y
	depends on DT_HAS_M5STACK_M5PM1_ADC_ENABLED
	select MFD
	help
	  Enable ADC support for the M5Stack M5PM1.

config ADC_M5PM1_INIT_PRIORITY
	int "M5PM1 ADC driver initialization priority"
	depends on ADC_M5PM1
	default 81
	help
	  Initialization priority for the M5PM1 ADC driver. It must be
	  greater than the MFD initialization priority.
```

## drivers/gpio/Kconfig.m5pm1
```kconfig
# Copyright (c) 2026 The Zephyr Project Contributors
# SPDX-License-Identifier: Apache-2.0
#
# Vendored from Zephyr PR #109961
# (commit 3dc118687506d146bca84d527bbf87e002e52df2), Apache-2.0.
# Interim copy; remove once #109961 merges upstream.
# See docs/07_UPSTREAM_PLAN.md.

config GPIO_M5PM1
	bool "M5Stack M5PM1 GPIO driver"
	default y
	depends on DT_HAS_M5STACK_M5PM1_GPIO_ENABLED
	select MFD
	help
	  Enable the GPIO controller driver for the M5Stack M5PM1.

config GPIO_M5PM1_INIT_PRIORITY
	int "M5PM1 GPIO driver initialization priority"
	depends on GPIO_M5PM1
	default 82
	help
	  Initialization priority for the M5PM1 GPIO driver. It must be
	  greater than the MFD initialization priority.
```

## drivers/regulator/Kconfig
```kconfig
# Copyright (c) 2026
# SPDX-License-Identifier: Apache-2.0

config REGULATOR_M5PM1
	bool "M5Stack M5PM1 PMIC regulator"
	default y
	depends on DT_HAS_M5STACK_M5PM1_L3B_REGULATOR_ENABLED
	select I2C
	select REGULATOR
	help
	  M5Stack M5PM1 PMIC single-rail (GPIO-switched) regulator driver.
	  Drives an M5PM1 GPIO high to enable a peripheral power domain (e.g.
	  GPIO2 = the "L3B" rail that powers the StickS3 LCD/MIC/SPK).

if REGULATOR_M5PM1

config REGULATOR_M5PM1_INIT_PRIORITY
	int "M5PM1 regulator init priority"
	default 75
	help
	  Device init priority for the M5PM1 regulator. Must be greater than
	  CONFIG_I2C_INIT_PRIORITY and less than the display init priority so the
	  rail is powered before the display is reset/initialized.

endif # REGULATOR_M5PM1

config EMUL_M5PM1
	bool "M5Stack M5PM1 PMIC emulator"
	default y
	depends on EMUL
	depends on DT_HAS_M5STACK_M5PM1_L3B_REGULATOR_ENABLED
	help
	  I2C emulator for the M5PM1 PMIC, for native_sim driver unit tests.
```

## dts/bindings/adc/m5stack,m5pm1-adc.yaml
```yaml
# Copyright (c) 2026 The Zephyr Project Contributors
# SPDX-License-Identifier: Apache-2.0
#
# Vendored from Zephyr PR #109961
# (commit 49788e986286245610c15fc36bd0cd73baba0011), Apache-2.0.
# Interim copy; #109961 MERGED upstream 2026-06-03 (drop when Zephyr is bumped past 4.4.0).
# See docs/07_UPSTREAM_PLAN.md.

description: M5Stack M5PM1 ADC

compatible: "m5stack,m5pm1-adc"

include: adc-controller.yaml

on-bus: m5pm1

properties:
  "#io-channel-cells":
    const: 1

io-channel-cells:
  - input
```

## dts/bindings/audio/m5stack,sticks3-amp.yaml
```yaml
# Copyright (c) 2026 Hsiu-Chi Tsai
# SPDX-License-Identifier: Apache-2.0

description: |
  M5Stack StickS3 on-board AW8737 speaker-amplifier enable line.

  The AW8737 mono amplifier shutdown/enable pin is driven by the M5PM1 PMIC
  GPIO3 (PYG3): driving it active un-mutes the speaker path. This node only
  carries the enable GPIO so the application (app/src/audio.c) can read it via
  GPIO_DT_SPEC_GET and drive the amp high strictly for the duration of a
  playback (anti-pop), leaving it inactive the rest of the time. No driver is
  bound to this compatible; it is a board-description leaf node.

  The M5PM1 GPIO child performs masked register writes, so toggling pin 3 does
  not disturb the neighbouring L3B/LCD power-rail bit on pin 2.

compatible: "m5stack,sticks3-amp"

properties:
  amp-gpios:
    type: phandle-array
    required: true
    description: |
      GPIO that enables the AW8737 speaker amplifier (active high). On the
      StickS3 this is the M5PM1 PMIC GPIO3 (PYG3).
```

## dts/bindings/gpio/m5stack,m5pm1-gpio.yaml
```yaml
# Copyright (c) 2026 The Zephyr Project Contributors
# SPDX-License-Identifier: Apache-2.0
#
# Vendored from Zephyr PR #109961
# (commit 3dc118687506d146bca84d527bbf87e002e52df2), Apache-2.0.
# Interim copy; #109961 MERGED upstream 2026-06-03 (drop when Zephyr is bumped past 4.4.0).
# See docs/07_UPSTREAM_PLAN.md.

description: M5Stack M5PM1 GPIO controller

compatible: "m5stack,m5pm1-gpio"

include: gpio-controller.yaml

on-bus: m5pm1

properties:
  "#gpio-cells":
    const: 2

gpio-cells:
  - pin
  - flags
```

## dts/bindings/mfd/m5stack,m5pm1.yaml
```yaml
# Copyright (c) 2026 The Zephyr Project Contributors
# SPDX-License-Identifier: Apache-2.0
#
# Vendored from Zephyr PR #109961
# (commit b9dde93c9a8173a884a3aabd7f08bc23260ae9e7), Apache-2.0.
# Interim copy; #109961 MERGED upstream 2026-06-03 (drop when Zephyr is bumped past 4.4.0).
# See docs/07_UPSTREAM_PLAN.md.

description: M5Stack M5PM1 PMIC (Power Management Integrated Circuit)

compatible: "m5stack,m5pm1"

include: i2c-device.yaml

bus: m5pm1

properties:
  reg:
    required: true
```

## dts/bindings/regulator/m5stack,m5pm1-l3b-regulator.yaml
```yaml
# Copyright (c) 2026
# SPDX-License-Identifier: Apache-2.0

description: |
  M5Stack M5PM1 PMIC GPIO-switched power rail, modeled as a Zephyr regulator.

  The M5PM1 (I2C 0x6E) gates the M5StickS3 peripheral domains via its GPIOs
  (PYG0..PYG4). The named M5PM1 GPIO is driven high to enable the rail. On
  StickS3, GPIO2 (PYG2) is the "L3B" switch that powers the LCD/MIC/SPK domain.
  This rail is a load switch, so there is no output voltage to set.

  This is an interim, single-rail binding. The canonical upstream M5PM1 support
  (MFD + gpio + adc + regulator) is being introduced by Zephyr PR #109961; the
  board should reuse that once merged. The "-l3b-" name keeps this binding
  distinct from the upstream "m5stack,m5pm1*" bindings.

  Mark the node `regulator-boot-on` so the rail is enabled at init (before the
  display is initialized).

compatible: "m5stack,m5pm1-l3b-regulator"

include:
  - name: regulator.yaml
  - name: i2c-device.yaml

properties:
  gpio:
    type: int
    required: true
    description: |
      M5PM1 GPIO index (0-4) that gates this rail. For the StickS3 LCD use 2.
```

## tests/drivers/audio_dsp/testcase.yaml
```yaml
tests:
  app.audio_dsp.logic:
    tags:
      - audio
    platform_allow:
      - native_sim
```

## tests/drivers/battery/testcase.yaml
```yaml
tests:
  app.battery.logic:
    tags:
      - power
    platform_allow:
      - native_sim
```

## tests/drivers/ir_nec/testcase.yaml
```yaml
tests:
  app.ir.nec:
    tags:
      - ir
      - nec
    platform_allow:
      - native_sim
```

## tests/drivers/m5pm1_mfd/testcase.yaml
```yaml
# Copyright (c) 2026 Hsiu-Chi Tsai
# SPDX-License-Identifier: Apache-2.0

tests:
  drivers.mfd.m5pm1:
    tags:
      - drivers
      - mfd
      - gpio
      - adc
      - regulator
    filter: dt_compat_enabled("m5stack,m5pm1")
    platform_allow:
      - native_sim
```

## tests/drivers/regulator/m5pm1/testcase.yaml
```yaml
tests:
  drivers.regulator.m5pm1:
    tags:
      - drivers
      - regulator
    filter: dt_compat_enabled("m5stack,m5pm1-l3b-regulator")
    platform_allow:
      - native_sim
```

## tests/drivers/wifi/testcase.yaml
```yaml
tests:
  app.wifi.logic:
    tags:
      - wifi
      - net
    platform_allow:
      - native_sim
```
